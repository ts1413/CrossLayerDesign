AUTOSAR XML (schema 4-0-3)
package /Ecuc
  module config Os: ecuc-def-edition=4.2.0, implementation-config-variant=VARIANT-PRE-COMPILE
    OsInclude: OsIncludeFileName=BlsmControl-app.h
    OsOS: OsNumberOfCores=2
    BlsmControl_AppMode (OsAppMode)
    4 x OsEvent:
      BlsmControl_WakeupEvent
      BlsmControl_InputEvent
      BlsmControl_OutputEvent
      BlsmControl_CompleteEvent
    4 x OsTask, all with OsTaskActivation=1, OsTaskSchedule=FULL, OsTaskEventRef=BlsmControl_WakeupEvent, OsTaskEventRef=BlsmControl_InputEvent, OsTaskEventRef=BlsmControl_OutputEvent, OsTaskEventRef=BlsmControl_CompleteEvent:
      BlsmControl_Core0_1_0_Task: OsTaskPriority=BlsmControl_Core0_1_0_Task_Priority, OsTaskStackSize=BlsmControl_Core0_1_0_Task_Stack
        OsTaskAutostart: OsTaskAppModeRef=BlsmControl_AppMode
      BlsmControl_Core1_1_0_Task: OsTaskPriority=BlsmControl_Core1_1_0_Task_Priority, OsTaskStackSize=BlsmControl_Core1_1_0_Task_Stack
        OsTaskAutostart: OsTaskAppModeRef=BlsmControl_AppMode
      BlsmControl_Core0_100_0_Task: OsTaskPriority=BlsmControl_Core0_100_0_Task_Priority, OsTaskStackSize=BlsmControl_Core0_100_0_Task_Stack
        OsTaskAutostart: OsTaskAppModeRef=BlsmControl_AppMode
      BlsmControl_Core1_100_0_Task: OsTaskPriority=BlsmControl_Core1_100_0_Task_Priority, OsTaskStackSize=BlsmControl_Core1_100_0_Task_Stack
        OsTaskAutostart: OsTaskAppModeRef=BlsmControl_AppMode
    4 x OsAlarm, all with OsAlarmCounterRef=MAIN_HW_COUNTER_CORE0:
      BlsmControl_Core0_1_0_Alarm
        OsAlarmAction
          OsAlarmSetEvent: OsAlarmSetEventTaskRef=BlsmControl_Core0_1_0_Task, OsAlarmSetEventRef=BlsmControl_WakeupEvent
      BlsmControl_Core1_1_0_Alarm
        OsAlarmAction
          OsAlarmSetEvent: OsAlarmSetEventTaskRef=BlsmControl_Core1_1_0_Task, OsAlarmSetEventRef=BlsmControl_WakeupEvent
      BlsmControl_Core0_100_0_Alarm
        OsAlarmAction
          OsAlarmSetEvent: OsAlarmSetEventTaskRef=BlsmControl_Core0_100_0_Task, OsAlarmSetEventRef=BlsmControl_WakeupEvent
      BlsmControl_Core1_100_0_Alarm
        OsAlarmAction
          OsAlarmSetEvent: OsAlarmSetEventTaskRef=BlsmControl_Core1_100_0_Task, OsAlarmSetEventRef=BlsmControl_WakeupEvent
    BlsmControl_OSAP_CORE0 (OsApplication):
      OsApplicationCoreAssignment = 0
      OsAppTaskRef = BlsmControl_Core0_1_0_Task
      OsAppTaskRef = BlsmControl_Core0_100_0_Task
      OsAlarmCounterRef = MAIN_HW_COUNTER_CORE0
      OsAppAlarmRef = BlsmControl_Core0_1_0_Alarm
      OsAppAlarmRef = BlsmControl_Core0_100_0_Alarm
      OsAppAlarmRef = BlsmControl_Core1_1_0_Alarm
      OsAppAlarmRef = BlsmControl_Core1_100_0_Alarm
      OsApplicationHooks: OsAppErrorHook=false, OsAppShutdownHook=false, OsAppStartupHook=false
    BlsmControl_OSAP_CORE1 (OsApplication): OsApplicationCoreAssignment=1, OsAppTaskRef=BlsmControl_Core1_1_0_Task, OsAppTaskRef=BlsmControl_Core1_100_0_Task
      OsApplicationHooks: OsAppErrorHook=false, OsAppShutdownHook=false, OsAppStartupHook=false
