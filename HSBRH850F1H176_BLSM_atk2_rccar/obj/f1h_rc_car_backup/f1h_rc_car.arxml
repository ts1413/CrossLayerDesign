AUTOSAR XML (schema 4-0-3)
package /Ecuc
  module config Os: ecuc-def-edition=4.2.0, implementation-config-variant=VARIANT-PRE-COMPILE
    OsOS: OsStackMonitoring=true, OsUseGetServiceId=true, OsUseParameterAccess=true, OsStatus=EXTENDED, OsScalabilityClass=SC1
      OsHooks: OsErrorHook=false, OsPostTaskHook=false, OsPreTaskHook=false, OsProtectionHook=false, OsShutdownHook=false, OsStartupHook=true
      OsHookStack: OsHookStackSize=512, OsHookStackCoreAssignment=0
      OsOsStack: OsOsStackSize=2384, OsOsStackCoreAssignment=0
    a_controller_AppMode (OsAppMode)
    debug_AppMode (OsAppMode)
    OperationManagerTask (OsTask): OsTaskActivation=1, OsTaskPriority=2, OsTaskStackSize=2048, OsTaskSchedule=FULL
    OperationManagerCycAlarm (OsAlarm): OsAlarmCounterRef=MAIN_HW_COUNTER_CORE0
      OsAlarmAction
        OsAlarmActivateTask: OsAlarmActivateTaskRef=OperationManagerTask
      OsAlarmAutostart:
        OsAlarmAlarmTime = TICK_FOR_10MS
        OsAlarmCycleTime = TICK_FOR_10MS
        OsAlarmAutostartType = ABSOLUTE
        OsAlarmAppModeRef = a_controller_AppMode
        OsAlarmAppModeRef = debug_AppMode
    DriveManagerTask (OsTask): OsTaskActivation=1, OsTaskPriority=3, OsTaskStackSize=2048, OsTaskSchedule=FULL
    DriveManagerCycAlarm (OsAlarm): OsAlarmCounterRef=MAIN_HW_COUNTER_CORE0
      OsAlarmAction
        OsAlarmActivateTask: OsAlarmActivateTaskRef=DriveManagerTask
      OsAlarmAutostart:
        OsAlarmAlarmTime = TICK_FOR_10MS*2
        OsAlarmCycleTime = TICK_FOR_10MS*2
        OsAlarmAutostartType = ABSOLUTE
        OsAlarmAppModeRef = a_controller_AppMode
        OsAlarmAppModeRef = debug_AppMode
    BodyControlTask (OsTask): OsTaskActivation=1, OsTaskPriority=2, OsTaskStackSize=2048, OsTaskSchedule=FULL
    BodyControlCycAlarm (OsAlarm): OsAlarmCounterRef=MAIN_HW_COUNTER_CORE0
      OsAlarmAction
        OsAlarmActivateTask: OsAlarmActivateTaskRef=BodyControlTask
      OsAlarmAutostart: OsAlarmAlarmTime=TICK_FOR_10MS*10, OsAlarmCycleTime=TICK_FOR_10MS*10, OsAlarmAutostartType=ABSOLUTE, OsAlarmAppModeRef=a_controller_AppMode
    BuzzerControlCycAlarm (OsAlarm): OsAlarmCounterRef=MAIN_HW_COUNTER_CORE0
      OsAlarmAction
        OsAlarmCallback: OsAlarmCallbackName=BuzzerControlCycAlarmCb
      OsAlarmAutostart: OsAlarmAlarmTime=TICK_FOR_10MS/80, OsAlarmCycleTime=TICK_FOR_10MS/80, OsAlarmAutostartType=ABSOLUTE, OsAlarmAppModeRef=a_controller_AppMode
    blsm_OSAP_CORE0 (OsApplication):
      OsApplicationCoreAssignment = 0
      OsAppTaskRef = OperationManagerTask
      OsAppTaskRef = DriveManagerTask
      OsAppTaskRef = BodyControlTask
      OsAppAlarmRef = OperationManagerCycAlarm
      OsAppAlarmRef = DriveManagerCycAlarm
      OsAppAlarmRef = BodyControlCycAlarm
      OsAppAlarmRef = BuzzerControlCycAlarm
      OsAppIsrRef = RLIN3x_TX_ISR
      OsAppIsrRef = RLIN3x_RX_ISR
      OsApplicationHooks: OsAppErrorHook=false, OsAppShutdownHook=false, OsAppStartupHook=false
