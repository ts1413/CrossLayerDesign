AUTOSAR XML (schema 4-0-3)
package /Ecuc
  module config Os: ecuc-def-edition=4.2.0, implementation-config-variant=VARIANT-PRE-COMPILE
    OsInclude: OsIncludeFileName=rlin3x.h
    RLIN3x_TX_ISR (OsIsr):
      OsIsrInterruptNumber = INTNO_RLIN3x_TX
      OsIsrInterruptPriority = INTPRI_RLIN3x_TX
      OsIsrCategory = CATEGORY_2
      OsIsrStackSize = 592
      OsIsrInterruptSource = ENABLE
    RLIN3x_RX_ISR (OsIsr):
      OsIsrInterruptNumber = INTNO_RLIN3x_RX
      OsIsrInterruptPriority = INTPRI_RLIN3x_RX
      OsIsrCategory = CATEGORY_2
      OsIsrStackSize = 592
      OsIsrInterruptSource = ENABLE
