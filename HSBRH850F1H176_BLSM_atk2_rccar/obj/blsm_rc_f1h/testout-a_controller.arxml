AUTOSAR XML (schema 4-0-3)
package /Ecuc
  module config Os: ecuc-def-edition=4.2.0, implementation-config-variant=VARIANT-PRE-COMPILE
    OsInclude: OsIncludeFileName=a_controller-app.h
    OsOS: OsNumberOfCores=2
    a_controller_AppMode (OsAppMode)
    4 x OsEvent:
      a_controller_WakeupEvent
      a_controller_InputEvent
      a_controller_OutputEvent
      a_controller_CompleteEvent
    4 x OsTask, all with OsTaskActivation=1, OsTaskSchedule=FULL, OsTaskEventRef=a_controller_WakeupEvent, OsTaskEventRef=a_controller_InputEvent, OsTaskEventRef=a_controller_OutputEvent, OsTaskEventRef=a_controller_CompleteEvent:
      a_controller_Core0_1_0_Task: OsTaskPriority=a_controller_Core0_1_0_Task_Priority, OsTaskStackSize=a_controller_Core0_1_0_Task_Stack
        OsTaskAutostart: OsTaskAppModeRef=a_controller_AppMode, OsTaskAppModeRef=debug_AppMode
      a_controller_Core1_1_0_Task: OsTaskPriority=a_controller_Core1_1_0_Task_Priority, OsTaskStackSize=a_controller_Core1_1_0_Task_Stack
        OsTaskAutostart: OsTaskAppModeRef=a_controller_AppMode, OsTaskAppModeRef=debug_AppMode
      a_controller_Core0_100_0_Task: OsTaskPriority=a_controller_Core0_100_0_Task_Priority, OsTaskStackSize=a_controller_Core0_100_0_Task_Stack
        OsTaskAutostart: OsTaskAppModeRef=a_controller_AppMode, OsTaskAppModeRef=debug_AppMode
      a_controller_Core1_100_0_Task: OsTaskPriority=a_controller_Core1_100_0_Task_Priority, OsTaskStackSize=a_controller_Core1_100_0_Task_Stack
        OsTaskAutostart: OsTaskAppModeRef=a_controller_AppMode, OsTaskAppModeRef=debug_AppMode
    4 x OsAlarm, all with OsAlarmCounterRef=MAIN_HW_COUNTER_CORE0:
      a_controller_Core0_1_0_Alarm
        OsAlarmAction
          OsAlarmSetEvent: OsAlarmSetEventTaskRef=a_controller_Core0_1_0_Task, OsAlarmSetEventRef=a_controller_WakeupEvent
      a_controller_Core1_1_0_Alarm
        OsAlarmAction
          OsAlarmSetEvent: OsAlarmSetEventTaskRef=a_controller_Core1_1_0_Task, OsAlarmSetEventRef=a_controller_WakeupEvent
      a_controller_Core0_100_0_Alarm
        OsAlarmAction
          OsAlarmSetEvent: OsAlarmSetEventTaskRef=a_controller_Core0_100_0_Task, OsAlarmSetEventRef=a_controller_WakeupEvent
      a_controller_Core1_100_0_Alarm
        OsAlarmAction
          OsAlarmSetEvent: OsAlarmSetEventTaskRef=a_controller_Core1_100_0_Task, OsAlarmSetEventRef=a_controller_WakeupEvent
    a_controller_OSAP_CORE0 (OsApplication):
      OsApplicationCoreAssignment = 0
      OsAppTaskRef = a_controller_Core0_1_0_Task
      OsAppTaskRef = a_controller_Core0_100_0_Task
      OsAlarmCounterRef = MAIN_HW_COUNTER_CORE0
      OsAppAlarmRef = a_controller_Core0_1_0_Alarm
      OsAppAlarmRef = a_controller_Core0_100_0_Alarm
      OsAppAlarmRef = a_controller_Core1_1_0_Alarm
      OsAppAlarmRef = a_controller_Core1_100_0_Alarm
      OsApplicationHooks: OsAppErrorHook=false, OsAppShutdownHook=false, OsAppStartupHook=false
    a_controller_OSAP_CORE1 (OsApplication): OsApplicationCoreAssignment=1, OsAppTaskRef=a_controller_Core1_1_0_Task, OsAppTaskRef=a_controller_Core1_100_0_Task
      OsApplicationHooks: OsAppErrorHook=false, OsAppShutdownHook=false, OsAppStartupHook=false
